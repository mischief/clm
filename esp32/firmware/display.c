// SPDX-License-Identifier: ISC
/*
 * ST7789 text console for the T-Deck. See display.h.
 *
 * Glyphs come from font8x16.h, generated by fonts/bdf2font.py from the Spleen
 * bitmap font (BSD-2-Clause); see fonts/LICENSE for the font's own terms.
 */
#include <string.h>

#include "driver/gpio.h"
#include "driver/spi_common.h"
#include "esp_lcd_panel_io.h"
#include "esp_lcd_panel_vendor.h"
#include "esp_lcd_panel_ops.h"
#include "esp_log.h"
#include "freertos/FreeRTOS.h"
#include "freertos/semphr.h"

#include "display.h"
#include "font8x16.h"

static const char *TAG = "clm_disp";

/* T-Deck ST7789 pins (shared SPI bus, initialized elsewhere). */
#define LCD_HOST      SPI2_HOST
#define LCD_CS        12
#define LCD_DC        11
#define LCD_BL        42
#define LCD_H_RES     320
#define LCD_V_RES     240
#define LCD_PCLK_HZ   (40 * 1000 * 1000)

#define COLS (LCD_H_RES / FONT_W) /* 40 */
#define ROWS (LCD_V_RES / FONT_H) /* 15 */

static esp_lcd_panel_handle_t s_panel;

/* esp_lcd draws are async DMA out of s_rowbuf; this is given from the panel-io
 * "color transfer done" callback so we never overwrite s_rowbuf mid-flight. */
static SemaphoreHandle_t s_draw_done;

static bool
lcd_trans_done(esp_lcd_panel_io_handle_t io, esp_lcd_panel_io_event_data_t *ed,
    void *ctx)
{
	(void)io;
	(void)ed;
	(void)ctx;
	BaseType_t hp = pdFALSE;
	xSemaphoreGiveFromISR(s_draw_done, &hp);
	return hp == pdTRUE;
}

/* Character grid + per-cell foreground color. */
static char s_ch[ROWS][COLS];
static uint16_t s_fg[ROWS][COLS];
static bool s_dirty[ROWS];
static int s_row, s_col;
static uint16_t s_cur_fg = DISP_WHITE;
static uint16_t s_bg = DISP_BLACK;

/* One text row of pixels (320x16), reused for every row draw. */
static uint16_t s_rowbuf[LCD_H_RES * FONT_H];

int
display_init(void)
{
	esp_err_t err;

	/* Backlight on. */
	gpio_config_t bl = {
		.pin_bit_mask = 1ULL << LCD_BL,
		.mode = GPIO_MODE_OUTPUT,
	};
	gpio_config(&bl);
	gpio_set_level(LCD_BL, 1);

	esp_lcd_panel_io_handle_t io = NULL;
	esp_lcd_panel_io_spi_config_t io_cfg = {
		.cs_gpio_num = LCD_CS,
		.dc_gpio_num = LCD_DC,
		.pclk_hz = LCD_PCLK_HZ,
		.lcd_cmd_bits = 8,
		.lcd_param_bits = 8,
		.spi_mode = 0,
		.trans_queue_depth = 10,
	};
	err = esp_lcd_new_panel_io_spi((esp_lcd_spi_bus_handle_t)LCD_HOST, &io_cfg,
	    &io);
	if (err != ESP_OK) {
		ESP_LOGE(TAG, "panel_io_spi: %s", esp_err_to_name(err));
		return -1;
	}

	s_draw_done = xSemaphoreCreateBinary();
	xSemaphoreGive(s_draw_done); /* first draw is free to proceed */
	esp_lcd_panel_io_callbacks_t cbs = { .on_color_trans_done = lcd_trans_done };
	esp_lcd_panel_io_register_event_callbacks(io, &cbs, NULL);

	esp_lcd_panel_dev_config_t panel_cfg = {
		.reset_gpio_num = -1, /* no dedicated reset line on the T-Deck */
		.rgb_ele_order = LCD_RGB_ELEMENT_ORDER_RGB,
		.bits_per_pixel = 16,
	};
	err = esp_lcd_new_panel_st7789(io, &panel_cfg, &s_panel);
	if (err != ESP_OK) {
		ESP_LOGE(TAG, "new_panel_st7789: %s", esp_err_to_name(err));
		return -1;
	}

	esp_lcd_panel_reset(s_panel);
	esp_lcd_panel_init(s_panel);
	esp_lcd_panel_invert_color(s_panel, true); /* ST7789 wants inversion on */
	/* 240x320 native -> 320x240 landscape. */
	esp_lcd_panel_swap_xy(s_panel, true);
	esp_lcd_panel_mirror(s_panel, true, false);
	esp_lcd_panel_disp_on_off(s_panel, true);

	console_clear();
	ESP_LOGI(TAG, "ST7789 console up: %dx%d chars", COLS, ROWS);
	return 0;
}

/* Render one text row into s_rowbuf and push it to the panel. */
static void
draw_row(int r)
{
	/* Wait for the previous row's DMA to finish reading s_rowbuf before we
	 * overwrite it -- esp_lcd_panel_draw_bitmap is asynchronous. */
	xSemaphoreTake(s_draw_done, portMAX_DELAY);
	for (int c = 0; c < COLS; c++) {
		unsigned char ch = (unsigned char)s_ch[r][c];
		const uint8_t *glyph = font8x16[ch];
		uint16_t fg = s_fg[r][c];
		for (int gy = 0; gy < FONT_H; gy++) {
			uint8_t bits = glyph[gy];
			uint16_t *dst = &s_rowbuf[gy * LCD_H_RES + c * FONT_W];
			for (int gx = 0; gx < FONT_W; gx++) {
				uint16_t px = (bits & (0x80 >> gx)) ? fg : s_bg;
				/* esp_lcd sends bytes as-is; ST7789 wants big-endian. */
				dst[gx] = (uint16_t)((px << 8) | (px >> 8));
			}
		}
	}
	esp_lcd_panel_draw_bitmap(s_panel, 0, r * FONT_H, LCD_H_RES,
	    (r + 1) * FONT_H, s_rowbuf);
}

void
console_flush(void)
{
	for (int r = 0; r < ROWS; r++) {
		if (s_dirty[r]) {
			draw_row(r);
			s_dirty[r] = false;
		}
	}
}

void
console_clear(void)
{
	for (int r = 0; r < ROWS; r++) {
		for (int c = 0; c < COLS; c++) {
			s_ch[r][c] = ' ';
			s_fg[r][c] = s_cur_fg;
		}
		s_dirty[r] = true;
	}
	s_row = s_col = 0;
	console_flush();
}

void
console_set_color(uint16_t fg)
{
	s_cur_fg = fg;
}

static void
scroll_up(void)
{
	memmove(&s_ch[0][0], &s_ch[1][0], (ROWS - 1) * COLS * sizeof(s_ch[0][0]));
	memmove(&s_fg[0][0], &s_fg[1][0], (ROWS - 1) * COLS * sizeof(s_fg[0][0]));
	for (int c = 0; c < COLS; c++) {
		s_ch[ROWS - 1][c] = ' ';
		s_fg[ROWS - 1][c] = s_cur_fg;
	}
	for (int r = 0; r < ROWS; r++)
		s_dirty[r] = true;
}

static void
newline(void)
{
	s_col = 0;
	if (s_row < ROWS - 1)
		s_row++;
	else
		scroll_up();
}

/* Place a raw glyph (by font index) into the grid, wrapping at the margin. */
static void
put_cell(uint8_t idx)
{
	if (s_col >= COLS)
		newline();
	s_ch[s_row][s_col] = (char)idx;
	s_fg[s_row][s_col] = s_cur_fg;
	s_dirty[s_row] = true;
	s_col++;
}

/* Emit one already-ASCII byte (glyph or control) into the grid. */
static void
put_glyph(char c)
{
	if (c == '\n') {
		newline();
		return;
	}
	if (c == '\r') {
		s_col = 0;
		return;
	}
	if (c == '\t') {
		int n = 4 - (s_col % 4);
		while (n-- > 0)
			put_glyph(' ');
		return;
	}
	if ((unsigned char)c < 0x20)
		return; /* skip other control chars */

	put_cell((uint8_t)c);
}

/* Look up a Unicode codepoint in the font's symbol map; -1 if absent. */
static int
symbol_index(uint32_t cp)
{
	int lo = 0, hi = FONT_NSYMBOLS - 1;
	while (lo <= hi) {
		int mid = (lo + hi) / 2;
		uint32_t c = font_symbols[mid].cp;
		if (cp == c)
			return font_symbols[mid].idx;
		if (cp < c)
			hi = mid - 1;
		else
			lo = mid + 1;
	}
	return -1;
}

/*
 * Map a Unicode codepoint to an ASCII replacement for glyphs the font lacks.
 * Covers the punctuation LLMs love (dashes, curly quotes, ellipsis, bullets,
 * math signs, arrows); everything else non-ASCII becomes '?'.
 */
static const char *
translit(uint32_t cp)
{
	switch (cp) {
	case 0x2018: /* ' */
	case 0x2019: /* ' */
	case 0x2032: /* prime */
		return "'";
	case 0x201C: /* " */
	case 0x201D: /* " */
	case 0x2033: /* double prime */
		return "\"";
	case 0x2010: /* hyphen */
	case 0x2011:
	case 0x2012:
	case 0x2013: /* en dash */
	case 0x2014: /* em dash */
	case 0x2015:
	case 0x2212: /* minus sign */
		return "-";
	case 0x2026: /* ellipsis */
		return "...";
	case 0x2022: /* bullet */
	case 0x2023:
	case 0x25CF:
	case 0x25AA:
		return "*";
	case 0x00D7: /* multiplication sign */
		return "x";
	case 0x00F7: /* division sign */
		return "/";
	case 0x2192: /* rightwards arrow */
		return "->";
	case 0x2190: /* leftwards arrow */
		return "<-";
	case 0x00A0: /* no-break space */
	case 0x2007:
	case 0x202F:
		return " ";
	case 0x2264:
		return "<=";
	case 0x2265:
		return ">=";
	case 0x2260:
		return "!=";
	default:
		return "?";
	}
}

void
console_putc(char c)
{
	/* Decode UTF-8 across calls: the agent output streams byte-by-byte. */
	static uint32_t cp;   /* codepoint being assembled */
	static int need;      /* continuation bytes still expected */
	unsigned char b = (unsigned char)c;

	if (need > 0) {
		if ((b & 0xC0) == 0x80) {
			cp = (cp << 6) | (b & 0x3F);
			if (--need == 0) {
				int gi;
				if (cp < 0x80)
					put_glyph((char)cp);
				else if ((gi = symbol_index(cp)) >= 0)
					put_cell((uint8_t)gi); /* real glyph */
				else
					for (const char *r = translit(cp); *r; r++)
						put_glyph(*r); /* ASCII fallback */
			}
			return;
		}
		need = 0; /* malformed sequence: drop it, reprocess b below */
	}

	if (b < 0x80) {
		put_glyph(c);
	} else if ((b & 0xE0) == 0xC0) {
		cp = b & 0x1F;
		need = 1;
	} else if ((b & 0xF0) == 0xE0) {
		cp = b & 0x0F;
		need = 2;
	} else if ((b & 0xF8) == 0xF0) {
		cp = b & 0x07;
		need = 3;
	} else {
		put_glyph('?'); /* stray continuation / invalid lead byte */
	}
}

void
console_puts(const char *s)
{
	if (s == NULL)
		return;
	for (; *s != '\0'; s++)
		console_putc(*s);
	console_flush();
}

/*
 * Dump the console as a hex-encoded RGB image over stdout (the same link the
 * chat output uses), framed by text sentinels so the host can slice it out of
 * the log stream. Rendered from the logical grid (s_ch/s_fg), so it is a
 * pixel-accurate view of console output. Hex keeps it immune to the USB-JTAG
 * console's LF translation; one text row per scanline.
 */
void
console_screenshot(void)
{
	static const char hexd[] = "0123456789abcdef";
	static char line[LCD_H_RES * 6 + 2]; /* "RRGGBB" per pixel + newline */

	printf("\nSHOT-BEGIN %d %d\n", COLS * FONT_W, ROWS * FONT_H);
	for (int py = 0; py < ROWS * FONT_H; py++) {
		int tr = py / FONT_H, gy = py % FONT_H;
		char *dst = line;
		for (int c = 0; c < COLS; c++) {
			const uint8_t *glyph = font8x16[(unsigned char)s_ch[tr][c]];
			uint8_t bits = glyph[gy];
			uint16_t fg = s_fg[tr][c];
			for (int gx = 0; gx < FONT_W; gx++) {
				uint16_t px = (bits & (0x80 >> gx)) ? fg : s_bg;
				uint8_t r = (px >> 11) & 0x1F, g = (px >> 5) & 0x3F,
					b = px & 0x1F;
				uint8_t r8 = (r << 3) | (r >> 2),
					g8 = (g << 2) | (g >> 4), b8 = (b << 3) | (b >> 2);
				*dst++ = hexd[r8 >> 4]; *dst++ = hexd[r8 & 0xf];
				*dst++ = hexd[g8 >> 4]; *dst++ = hexd[g8 & 0xf];
				*dst++ = hexd[b8 >> 4]; *dst++ = hexd[b8 & 0xf];
			}
		}
		*dst++ = '\n';
		*dst = '\0';
		fputs(line, stdout);
	}
	printf("SHOT-END\n");
	fflush(stdout);
}

void
console_backspace(void)
{
	if (s_col == 0)
		return;
	s_col--;
	s_ch[s_row][s_col] = ' ';
	s_dirty[s_row] = true;
	console_flush();
}
